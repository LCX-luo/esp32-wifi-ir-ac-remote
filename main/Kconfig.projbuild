## main/Kconfig.projbuild
```kconfig
menu "AC Remote Configuration"

    config AC_WIFI_SSID
        string "WiFi SSID"
        default "your_ssid"
        help
            SSID (network name) of the router to connect to.

    config AC_WIFI_PASSWORD
        string "WiFi Password"
        default ""
        help
            WiFi password (WPA/WPA2/WPA3) for the router.

    config AC_MQTT_BROKER_URI
        string "MQTT Broker URI"
        default "mqtt://broker.emqx.io"
        help
            MQTT broker address. Use mqtt:// for plain TCP (port 1883)
            or mqtts:// for TLS. Public free broker: mqtt://broker.emqx.io

    config AC_MQTT_USERNAME
        string "MQTT Username (optional)"
        default ""
        help
            Username for broker authentication. Leave empty if not used.

    config AC_MQTT_PASSWORD
        string "MQTT Password (optional)"
        default ""
        help
            Password for broker authentication. Leave empty if not used.

    config AC_MQTT_TOPIC_PREFIX
        string "MQTT Topic Prefix"
        default "/ac-remote"
        help
            Topic prefix used for all devices of this project.
            Full topics: {prefix}/{device_id}/cmd and {prefix}/{device_id}/status
            device_id is the last 3 bytes of the WiFi MAC (hex).

endmenu
```
